## demo/a2dp_sink/sdkconfig.defaults.korvo1
```kconfig
# ESP32-S31-Korvo-1 headless Classic Bluetooth audio demo.

#
# Bootloader and flash
#
CONFIG_BOOTLOADER_LOG_LEVEL_WARN=y
CONFIG_ESPTOOLPY_FLASHFREQ_80M=y
CONFIG_ESPTOOLPY_FLASHFREQ="80m"
CONFIG_ESPTOOLPY_FLASHSIZE_16MB=y
CONFIG_ESPTOOLPY_FLASHSIZE="16MB"

#
# Partition table
#
CONFIG_PARTITION_TABLE_CUSTOM=y
CONFIG_PARTITION_TABLE_CUSTOM_FILENAME="partitions_esp32s31.csv"
CONFIG_PARTITION_TABLE_FILENAME="partitions_esp32s31.csv"
CONFIG_PARTITION_TABLE_OFFSET=0xA000

#
# Classic Bluetooth: A2DP Sink + AVRCP only
#
CONFIG_BT_ENABLED=y
CONFIG_BT_CONTROLLER_ENABLED=y
# CONFIG_BT_CONTROLLER_DISABLED is not set
CONFIG_BT_BLUEDROID_ENABLED=y
# CONFIG_BT_NIMBLE_ENABLED is not set
# CONFIG_BT_CONTROLLER_ONLY is not set
CONFIG_BT_CLASSIC_ENABLED=y
CONFIG_BT_A2DP_ENABLE=y
CONFIG_BT_A2DP_USE_EXTERNAL_CODEC=y
CONFIG_BT_AVRCP_ENABLED=y
# CONFIG_BT_AVRCP_CT_COVER_ART_ENABLED is not set
# CONFIG_BT_HFP_ENABLE is not set
# CONFIG_BT_BLE_ENABLED is not set
CONFIG_BTDM_CTRL_MODE_BR_EDR_ONLY=y

#
# Demo roles
#
CONFIG_GMF_EXAMPLE_AUDIO_TECH_CLASSIC=y
CONFIG_GMF_EXAMPLE_A2DP_SINK=y
CONFIG_GMF_EXAMPLE_AVRC_CT=y
CONFIG_GMF_EXAMPLE_AVRC_TG=y
# CONFIG_GMF_EXAMPLE_HFP_HF is not set
# CONFIG_GMF_EXAMPLE_PBAP_PCE is not set
# CONFIG_GMF_EXAMPLE_AUDIO_TECH_LE is not set
# CONFIG_EXAMPLE_BT_UI_ENABLE is not set

#
# Audio pipeline and memory
#
CONFIG_ESP_BT_AUDIO_GMF_IO_SUPPORT=y
CONFIG_SPIRAM=y
CONFIG_FREERTOS_HZ=1000
```
